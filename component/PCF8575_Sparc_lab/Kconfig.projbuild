## component/PCF8575_Sparc_lab/Kconfig.projbuild
```kconfig
menu "PCF8575 configuration"

    config PCF8575_PORT_I2C
        int "PCF8575_PORT_I2C"
        default 0
        help
            PORT I2C

    config PCF8575_SDA_GPIO
        int "PCF8575_SDA_GPIO"
        default 21
        help    
            GPIO for SDA

    config PCF8575_SCL_GPIO
        int "PCF8575_SCL_GPIO"
        default 22
        help 
            GPIO for SCL

    config PCF8575_INTERRUPT_GPIO
        int "PCF8575_INTERUPT_GPIO"
        default 17
        help
            GPIO number for TX.

    config PCF8575_ADDRESS
        hex "PCF575_ADDRESS"
        default 0x40
        help
            0x40    // A[2]A[1]A[0] = 000  
            0X42    // A[2]A[1]A[0] = 001   
            0X44    // A[2]A[1]A[0] = 010 
            0X46    // A[2]A[1]A[0] = 011 
            0X48    // A[2]A[1]A[0] = 100 
            0X4A    // A[2]A[1]A[0] = 101 
            0x4C    // A[2]A[1]A[0] = 110 
            0x4E    // A[2]A[1]A[0] = 111 




endmenu
```

## pcf8575_pro/Kconfig.projbuild
```kconfig
menu "PCF8575 configuration"

config ADDRESS_PCF8575
    hex "Address pcf8575"
    default 0x40
    help
        Address default of pcf8575

config INTERRUPT_ENABLE
    bool "Enable interrupt ON/OFF"
    default y
    help 
        Enable or Disable interrup for pcf8575
if INTERRUPT_ENABLE 
config PCF8575_INTERRUPT_PIN
    int "Interrupt pin number"
    default 5
    help 
        Specify the GPIO pin number to be used for interrupt configuration
endif

endmenu

    
```
